## prj.conf
```kconfig
#actions sdk config
CONFIG_ACTIONS_SDK=y
CONFIG_ACTIONS_SDK_FULL_MODE=y
#CONFIG_ACTIONS_SDK_TINY_MODE=y
#soc config
CONFIG_WATCHDOG=y
CONFIG_WDT_MODE_RESET=y
CONFIG_MPU_ACTS=y
CONFIG_ACTIONS_TRACE=y

#auto test config
CONFIG_ACTIONS_ATT=y
CONFIG_ATT_CYCLIC_TEST=n

#app config
CONFIG_BT_MAIN_APP=y
CONFIG_BT_MUSIC_APP=y
CONFIG_BT_CALL_APP=y
CONFIG_BT_CALL_FORCE_PLAY_PHONE_NUM=n
CONFIG_TWS_APP=y
CONFIG_AUDIO_INPUT_APP=y
CONFIG_LINE_IN_APP=y
CONFIG_SPDIF_IN_APP=n
CONFIG_I2SRX_IN_APP=n
CONFIG_MIC_IN_APP=n
CONFIG_RECORD_APP=n
CONFIG_RECORD_SERVICE=n
CONFIG_USOUND_APP=y
CONFIG_USOUND_SPEAKER=y
CONFIG_USOUND_MIC=n
CONFIG_CARD_READER_APP=y
CONFIG_CHARGER_APP=y
CONFIG_ALARM_APP=n
CONFIG_FM_APP=y
CONFIG_GMA_APP=n
CONFIG_GMA_APP_APK_TEST=n
CONFIG_GMA_APP_SUPPORT_OTA=n

CONFIG_DMA_APP=n
CONFIG_DMA_PHONE_WAKEUP=y

CONFIG_LCMUSIC_APP=y
CONFIG_DISK_MUSIC_APP=n
CONFIG_FORMAT_CHECK=y
CONFIG_AGING_PLAYBACK=n

#ota config
CONFIG_OTA_UPGRADE=y
CONFIG_OTA_APP=y
CONFIG_OTA_BACKGROUND=n
CONFIG_OTA_FOREGROUND=y
CONFIG_OTA_BACKEND_SDCARD=y
CONFIG_OTA_BACKEND_BLUETOOTH=y
CONFIG_SYSTEM_RECOVERY=n

#display config
CONFIG_LED=n
CONFIG_SEG_LED=y
CONFIG_LCD=n
CONFIG_GUI=n
CONFIG_UGUI=n
CONFIG_UGUI_TINY_MODE=n

CONFIG_SYS_LOG_DEFAULT_LEVEL=3
CONFIG_SYS_USER_LOG_DEFAULT_LEVEL=3

CONFIG_INPUT_MUTIPLE_CLICK=y
CONFIG_AUTO_STANDBY_TIME_SEC=60
CONFIG_AUTO_POWEDOWN_TIME_SEC=300

#################蓝牙相关配置##########################
#blutooth config
CONFIG_BT_DRV=y
CONFIG_BT_DRV_WOODPECKER_PHOENIX=y

CONFIG_BT_ACTIONS=y
CONFIG_TWS=y
CONFIG_TWS_BACKGROUND_BT=n
CONFIG_TWS_MONO_MODE=n
CONFIG_CSB=n

CONFIG_BT_BREDR=y
CONFIG_BT_A2DP=y
CONFIG_BT_AVRCP=y
CONFIG_BT_HFP_HF=y
CONFIG_BT_HFP_MSBC=y
CONFIG_BT_HFP_HF_VOL_SYNC=y
CONFIG_BT_AVRCP_VOL_SYNC=y
CONFIG_BT_DOUBLE_PHONE=n

CONFIG_BT_BLE=y

#used for btstack
CONFIG_BT_MAX_CONN=3
CONFIG_BT_MAX_BR_CONN=2
CONFIG_BT_MAX_SCO_CONN=2
CONFIG_BT_MAX_PAIRED=3
CONFIG_BT_MAX_BR_PAIRED=2
CONFIG_BT_DEBUG_LOG=n

CONFIG_BT_CONTROLER_DEBUG_PRINT=y
CONFIG_BT_CONTROLER_DEBUG_GPIO=n
# max tx power: 8.0db
CONFIG_BT_CONTROLER_MAX_TXPOWER=80

CONFIG_BT_CONTROLER_BQB=y
CONFIG_BT_CONTROLER_BLE_BQB=n
CONFIG_BT_CONTROLER_RF_FCC=n

# USB device
CONFIG_USB=y
# USB_AOTG_DC_MULTI_FIFO is for USB_MASS_STORAGE only!
CONFIG_USB_AOTG_DC_MULTI_FIFO=y
CONFIG_USB_DEVICE_STUB=n

#USB cdc acm device
#CONFIG_USB_CDC_ACM=n
#CONFIG_CDC_ACM_DESC_STATIC=n
#CONFIG_UART_LINE_CTRL=y
#CONFIG_SYS_LOG_USB_CDC_ACM_LEVEL=4
#CONFIG_USB_CDC_ACM_MANUFACTURER="Actions"
#CONFIG_USB_CDC_ACM_PRODUCT="CDC-ACM"
#CONFIG_USB_CDC_ACM_SN="0123456789A"

# USB HID CLASS
CONFIG_USB_DEVICE_HID=y
CONFIG_USB_HID_DEVICE_IF_NUM=0
CONFIG_HID_INTERRUPT_IN_EP_ADDR=0x81
CONFIG_HID_INTERRUPT_IN_EP_MPS=64
CONFIG_HID_INTERRUPT_OUT=y
CONFIG_HID_INTERRUPT_OUT_EP_ADDR=0x01
CONFIG_HID_INTERRUPT_OUT_EP_MPS=64
CONFIG_HID_INTERRUPT_EP_INTERVAL_HS=0x04
CONFIG_HID_INTERRUPT_EP_INTERVAL_FS=0x01
CONFIG_USB_SELF_DEFINED_REPORT=y
CONFIG_HID_REPORT_DESC_SIZE=297

# USB AUDIO CLASS
#CONFIG_USB_AUDIO_SOURCESINK=y
#CONFIG_USB_AUDIO_DEVICE_IF_NUM=1
#CONFIG_USB_AUDIO_DEVICE_MANUFACTURER="Actions"
#CONFIG_USB_AUDIO_DEVICE_PRODUCT="USB Audio & HID"
#CONFIG_USB_AUDIO_DEVICE_SN="0123456789AB"
#CONFIG_USB_AUDIO_SOURCE_IN_EP_ADDR=0x82
#CONFIG_USB_AUDIO_UPLOAD_CHANNEL_NUM=1
#CONFIG_USB_AUDIO_SINK_OUT_EP_ADDR=0x02
#CONFIG_USB_AUDIO_DOWNLOAD_CHANNEL_NUM=2
#CONFIG_USB_AUDIO_SINK_SAMPLE_FREQ_TYPE=1
#CONFIG_USB_AUDIO_SINK_RESOLUTION=16
#CONFIG_USB_AUDIO_CONTROL_UNIT=y
#CONFIG_SUPPORT_HD_AUDIO_PLAY=n
#CONFIG_SUPPORT_USB_AUDIO_SOURCE=y
#CONFIG_USB_AUDIO_SINK_MAINCH_CONFIG=0x01
#CONFIG_USB_AUDIO_SINK_LOGICALCH01_CONFIG=0x02
#CONFIG_USB_AUDIO_SINK_LOGICALCH02_CONFIG=0x02
#CONFIG_USB_DEVICE_HID=y
#CONFIG_USB_HID_DEVICE_IF_NUM=0
#CONFIG_HID_INTERRUPT_IN_EP_ADDR=0x81
#CONFIG_HID_INTERRUPT_IN_EP_MPS=64
#CONFIG_HID_INTERRUPT_OUT=y
#CONFIG_HID_INTERRUPT_OUT_EP_ADDR=0x01
#CONFIG_HID_INTERRUPT_OUT_EP_MPS=64
#CONFIG_HID_INTERRUPT_EP_INTERVAL_HS=0x04
#CONFIG_HID_INTERRUPT_EP_INTERVAL_FS=0x01
#CONFIG_USB_SELF_DEFINED_REPORT=y
#CONFIG_HID_REPORT_DESC_SIZE=102

#USB MSC CLASS
CONFIG_USB_MASS_STORAGE=n
#card reader
CONFIG_MASS_STORAGE_DISK_NAME="SD"
CONFIG_MASS_STORAGE_DISK_PDRV=4
#card reader(no media)
#CONFIG_MASS_STORAGE_DISK_NAME="NO_LUN"
#CONFIG_MASS_STORAGE_DISK_PDRV=0xff
CONFIG_MASS_STORAGE_IN_EP_ADDR=0x81
CONFIG_MASS_STORAGE_OUT_EP_ADDR=0x02
CONFIG_MASS_STORAGE_BULK_EP_MPS=512

# USB host
CONFIG_USB_HOST=n
CONFIG_USB_HOST_STORAGE=n
CONFIG_DISKIO_CACHE=y

# tool
CONFIG_TOOL=y
CONFIG_STUB_DEV=y
CONFIG_TOOL_ASET=y
CONFIG_TOOL_ASQT=y
CONFIG_TOOL_ECTT=n

#CONFIG_DETECT_MEMLEAK=y
#CONFIG_MEMORY_ANALYSIS=y

# tracing
CONFIG_TRACING=n
CONFIG_TRACING_CORE=y
CONFIG_TRACING_SYNC=n
CONFIG_TRACING_ASYNC=y
CONFIG_TRACING_ATRACE=y
CONFIG_TRACING_ATRACE_SHELL=n
CONFIG_TRACING_BACKEND_HEXDUMP=n
CONFIG_TRACING_BACKEND_SPI=y
CONFIG_TRACING_BUFFER_SIZE=2048
TRACING_THREAD_WAIT_THRESHOLD=50
#CONFIG_TRACING_BACKEND_SPI_BY_SPI_DRIVER=n
#CONFIG_TRACING_BACKEND_SPI_USE_DMA=y
#CONFIG_VDMA_ACTS_PCHAN_START=3
#CONFIG_VDMA_ACTS_PCHAN_NUM=5

CONFIG_CONSOLE_SHELL_PRIORITY=-10

# audio
CONFIG_AUDIO_OUT_STEREO_ENABLE=y
CONFIG_AUDIO_OUT_LEFT_RIGHT_SWAP=n
CONFIG_AUDIO_OUT_LEFT_ONLY=n
CONFIG_AUDIO_OUT_RIGHT_ONLY=n
CONFIG_AUDIO_OUTPUT_I2S=n
CONFIG_AUDIO_OUTPUT_SPDIF=n
CONFIG_AUDIO_OUTPUT_DAC_AND_I2S=n
CONFIG_MEDIA_EFFECT=y
CONFIG_MUSIC_EFFECT=y
CONFIG_MUSIC_DRC_EFFECT=y
CONFIG_VOICE_EFFECT=y
CONFIG_OUTPUT_RESAMPLE=n

# media
CONFIG_ACTIONS_ENCODER=y
CONFIG_ENCODER_CVSD=y
CONFIG_ENCODER_SBC=y
CONFIG_ENCODER_MP3=n
CONFIG_ENCODER_OPUS=n
CONFIG_ENCODER_PCM=y
CONFIG_ENCODER_WAV=y
CONFIG_ACTIONS_DECODER=y
CONFIG_DECODER_AAC=n
CONFIG_DECODER_ACT=n
CONFIG_DECODER_APE=n
CONFIG_DECODER_CVSD=y
CONFIG_DECODER_SBC=y
CONFIG_DECODER_PCM=y
CONFIG_DECODER_MP3=y
CONFIG_DECODER_FLAC=n
CONFIG_DECODER_WAV=y
CONFIG_DECODER_WMA=y

#btbox test
CONFIG_BT_BOX_TEST=n
CONFIG_TEST_BLE_NOTIFY=n

#hotplug
CONFIG_HOTPLUG=n
CONFIG_LINEIN_HOTPLUG=n
CONFIG_USB_HOTPLUG=n
CONFIG_CARD_HOTPLUG=n
CONFIG_CHARGER_HOTPLUG=n

#debug
CONFIG_SYS_LOG_SHOW_COLOR=y
```

## src/system_app_main.c
```c
/*
 * Copyright (c) 2012-2014 Wind River Systems, Inc.
 *
 * SPDX-License-Identifier: Apache-2.0
 */

#include <stdlib.h>
#include <string.h>
#include <misc/printk.h>
#include <usb/usb_device.h>
#include <drivers/usb/usb_phy.h>
#include <logging/sys_log.h>
#include <class/usb_audio.h>
#include <class/usb_stub.h>
#include <class/usb_msc.h>

#include "usb_uac_handler.h"
#include "usb_hid_handler.h"

#define UNINSTALL_TEST 0

#ifdef CONFIG_SUPPORT_USB_AUDIO_SOURCE
static u8_t MIC_DAT[] = "66cdefghijklmnopqrstuvwxyz123456";
#endif

#if  UNINSTALL_TEST
void usb_dev_uninstall_test(void);
#endif

extern int usb_hid_test_init(struct device *dev);

void main(void)
{
	usb_phy_init();
	usb_phy_enter_b_idle();
	usb_hid_test_init(NULL);
#if 0
	usb_dev_composite_pre_init(NULL);
	usb_hid_test_init(NULL)
	usb_stub_init(NULL);
	usb_mass_storage_init(NULL);
#endif
	while (1) {
		k_sleep(MSEC(500));

		/* test for usb audio source */
#ifdef CONFIG_SUPPORT_USB_AUDIO_SOURCE
		if (usb_audio_tx_enabled()) {
			SYS_LOG_DBG("tx audio source dat");
			usb_audio_tx(MIC_DAT, strlen(MIC_DAT));
		}
#endif

#if UNINSTALL_TEST
		usb_dev_install_uninstall_test();
#endif

	}
}


#if UNINSTALL_TEST
void usb_dev_uninstall_test(void)
{

	u8_t cnt = 0;

	u32_t count = 0;

	while (1) {
		k_sleep(1000);
		k_sleep(1000);
		k_sleep(1000);
		cnt++;
		if (cnt == 8) {
			SYS_LOG_ERR("cnt=%d\r\n", cnt);
			SYS_LOG_WRN("usb_device_init()");
#if 0
			usb_dev_composite_pre_init(NULL);
			usb_stub_init(NULL);
			usb_mass_storage_init(NULL);
#endif

		} else if (cnt == 16) {
			SYS_LOG_ERR("cnt=%d\r\n", cnt);
			cnt = 0;
			SYS_LOG_WRN("usb_device_exit()");
#if 0
			usb_dev_composite_del_init();
			usb_stub_exit();
			usb_mass_storage_exit();
#endif
			count++;
			SYS_LOG_ERR("count=%d\r\n", count);
		} else {
			SYS_LOG_WRN("cnt=%d\r\n", cnt);
		}
	}
}
#endif
```
